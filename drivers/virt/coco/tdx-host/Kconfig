## drivers/virt/coco/tdx-host/Kconfig
```kconfig
config TDX_HOST_SERVICES
	tristate "TDX Host Services Driver"
	depends on INTEL_TDX_HOST
	default m
	help
	  Enable access to TDX host services like module update and
	  extensions (e.g. TDX Connect).

	  Say y or m if enabling support for confidential virtual machine
	  support (CONFIG_INTEL_TDX_HOST). The module is called tdx_host.ko

config INTEL_TDX_MODULE_UPDATE
	bool "Intel TDX module runtime update"
	depends on TDX_HOST_SERVICES
	select FW_LOADER
	select FW_UPLOAD
	help
	  This enables the kernel to support TDX module runtime update. This
	  allows the admin to update the TDX module to another compatible
	  version without the need to terminate running TDX guests.

	  If unsure, say N.
```
